## drivers/parrot/Kconfig
```kconfig
menu "Parrot drivers"
source "drivers/parrot/net/Kconfig"
source "drivers/parrot/char/Kconfig"
source "drivers/parrot/usb/otg/Kconfig"
source "drivers/parrot/usb/serial/blackberry/Kconfig"
source "drivers/parrot/sound/soc/codecs/Kconfig"
source "drivers/parrot/input/touchscreen/Kconfig"
source "drivers/parrot/power/Kconfig"
source "drivers/parrot/i2c/Kconfig"
menu "InvenSense"
source "drivers/parrot/invensense/inv_mpu/Kconfig"
endmenu
endmenu
```

## drivers/parrot/char/Kconfig
```kconfig
config PARROT_GPIO
	tristate "gpio"
	help
		Allow userspace to drive gpio
		
config PARROT_PWM
	tristate "pwm"
	help
		Allow userspace to drive pwm
```

## drivers/parrot/i2c/Kconfig
```kconfig
config PARROT_MCLAREN_INPUT
	bool "mclaren input"
	help
		Support mclaren input over lvds

config PARROT_SMSC_USB82514_USB_HUB
	tristate "SMSC USB82514 USB HUB"
	depends on I2C
	help
		Automotive Grade USB 2.0 Hi-Speed 4-Port Hub
```

## drivers/parrot/input/touchscreen/Kconfig
```kconfig
if INPUT_TOUCHSCREEN


config TOUCHSCREEN_ATMEL_MXT
	tristate "Atmel mXT I2C Touchscreen"
	depends on I2C
	help
	  Say Y here if you have Atmel mXT series I2C touchscreen,
	  such as AT42QT602240/ATMXT224, connected to your system.

	  If unsure, say N.

	  To compile this driver as a module, choose M here: the
	  module will be called atmel_mxt_ts.

config TOUCHSCREEN_TNX_MXT
	tristate "TouchNetiX-Atmel mXT I2C Touchscreen"
	depends on I2C
	help
	  Say Y here if you have TouchNetiX-Atmel mXT series I2C touchscreen,
	  such as ATMXT224E V2, connected to your system.

	  If unsure, say N.

	  To compile this driver as a module, choose M here: the
	  module will be called tnx_mxt_ts.

config TOUCHSCREEN_ROHM_BU21023
	tristate "ROHM BU21023 driver"
	depends on I2C
	help
	  Say Y here if you have a touchscreen interface using the
	  synaptics controller

	  If unsure, say N (but it's safe to say "Y").

endif
```

## drivers/parrot/net/wireless/88w8787/Kconfig
```kconfig
menuconfig 88W8787
        tristate "Marvell 88W8787 wireless driver"
	depends on MMC
        default n
        help
          If you have this Marvel chip on your board you should say Y.

if 88W8787
source "drivers/parrot/net/wireless/88w8787/wlan/Kconfig"
endif
```

## drivers/parrot/net/wireless/Kconfig
```kconfig
source "drivers/parrot/net/wireless/88w8688/Kconfig"
source "drivers/parrot/net/wireless/88w8787/Kconfig"
```

## drivers/parrot/sound/soc/codecs/Kconfig
```kconfig
config SND_SOC_FC6100_I2S_CODECS
       tristate "Nuvoton NAU8820 and other I2S slave codecs"
	depends on SND_OMAP_SOC && SND_OMAP_SOC_MCBSP && MACH_OMAP_FC6100 && I2C
	help
	  Say Y if you want to add Nuvoton WAU8822\NAU8820 I2S codecs and other I2S slave codecs (without Pal codec) on FC6100
```

## drivers/parrot/usb/otg/Kconfig
```kconfig
config PARROT_DUMMY_SMSC43340_USB
	tristate "SMCM43340 USB"
    	depends on ARM
	help
		SMCM 43340 USB for USB OTG on FC6100 OMAP 3630
```

## drivers/video/omap2/displays/Kconfig
```kconfig
menu "OMAP2/3 Display Device Drivers"
        depends on OMAP2_DSS

config PANEL_GENERIC
        tristate "Generic Panel"
	default y
        help
	  Generic panel driver.
	  Used for DVI output for Beagle and OMAP3 SDP.

config PANEL_CHIMEI
        tristate "Chimei LCD Panel"
        depends on OMAP2_DSS
        help
          LCD Panel used on Fidji

config PANEL_SHARP_LS037V7DW01
        tristate "Sharp LS037V7DW01 LCD Panel"
        depends on OMAP2_DSS
	default y
        select BACKLIGHT_CLASS_DEVICE
        help
          LCD Panel used in TI's SDP3430 and EVM boards

config PANEL_SHARP_LQ043T1DG01
        tristate "Sharp LQ043T1DG01 LCD Panel"
        depends on OMAP2_DSS
        help

          LCD Panel used in TI's OMAP3517 EVM boards

config PANEL_TOSHIBA_LT104AC36100
	tristate "Toshiba Display LT104AC36100 (Parrot OEM)"
        depends on OMAP2_DSS
	help
	  This is the 10' LCD panel used by Parrot OEM on FC6100

config PANEL_PICO_DLP
        tristate "OMAP PICO DLP Panel"
        depends on OMAP2_DSS
        help
          LCD Panel used in TI's SDP4430 and EVM boards

config PANEL_TAAL
        tristate "Taal DSI Panel"
        depends on OMAP2_DSS_DSI
        help
          Taal DSI command mode panel from TPO.

config PANEL_NEC_NL8048HL11_01B
        tristate "NEC NL8048HL11-01B Panel"
	depends on OMAP2_DSS
	default y
        help
          LCD Panel used in the Zoom boards

config PANEL_SIL9022
       tristate "HDMI interface"
       help
               HDMI interface used in the Zoom board

config PANEL_TOPPOLY_TDO35S
        tristate "Toppoly TDO35S LCD Panel support"
        depends on OMAP2_DSS
        help
          LCD Panel used in CM-T35

config PANEL_TPO_TD043MTEA1
        tristate "TPO TD043MTEA1 LCD Panel"
        depends on OMAP2_DSS && SPI
        help
          LCD Panel used in OMAP3 Pandora

config PANEL_ACX565AKM
	tristate "ACX565AKM Panel"
	depends on OMAP2_DSS_SDI
	select BACKLIGHT_CLASS_DEVICE
	help
	  This is the LCD panel used on Nokia N900

config PANEL_LAJ07T001A
	tristate "TPO Display LAJ07T001A (Parrot OEM Client)"
        depends on OMAP2_DSS
	help
	  This is the LCD panel used by Parrot OEM on FC6100

config PANEL_KYOCERATCG101
	tristate "Kyocera TCG101"
        depends on OMAP2_DSS
	help
	  This is a LCD panel used by Parrot OEM on FC6100

endmenu
```
